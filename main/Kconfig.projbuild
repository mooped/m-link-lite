## main/Kconfig.projbuild
```kconfig
menu "M-Link Configuration"

    config BOT_NAME
        string "Robot Name"
        default "My Robot"
        help
            Robot name for display purposes.

    config BUTTON
        boolean "Button"
        default true
        help
            Board has a button to reset to default configuration.

    config HEXAPOD
        boolean "Hexapod"
        default false
        help
            Combine the internal PCA9685 and an external PCA9685 on address 0x82/0x81 for 19 total servo outputs.
            Motors are not usable in this mode due to the low PWM frequency required for the servos.

    config PLUS
        boolean "Plus"
        depends on !HEXAPOD
        default false
        help
            Board is an M-Link Plus with a PCA9685 and DRV8837 motor drivers.

    config PCA9865_FEEDBACK
        boolean "PCA9685 Feedback"
        depends on PLUS && !HEXAPOD
        default false
        help
            Use precise servo timings driven from a feedback line from the PCA9685.
            This feature is experimental, can consume a lot of resources, and is very timing dependent.

    config ESP_WIFI_SSID
        string "WiFi SSID"
        default "myssid"
        help
            SSID (network name) for the AP.

    config ESP_WIFI_PASSWORD
        string "WiFi Password"
        default "mypassword"
        help
            WiFi password (WPA or WPA2) for the AP.

    config ESP_MAX_STA_CONN
        int "Maximum STA connections"
        default 4
        help
            Maximum number of STA connections to the AP.

    config HOSTNAME_PREFIX
        string "Hostname prefix."
        default "m-link"
        help
            Prefix for hostname and SoftAP mode SSID.

    config ESP_WIFI_AP_PASSWORD
        string "SoftAP Mode Password"
        default "password"
        help
            Password, or password secret key for SoftAP mode.

    config ESP_WIFI_AP_GENERATE_PASSWORD
        boolean "SoftAP Generate Password"
        default false
        help
            When off the SoftAP Mode Password is used directly as a password, otherwise it is used as a secret key to generate a unique password.

    config ESP_MAXIMUM_RETRY
        int "Maximum Retry"
        default 5
        help
            Maximum number of retries when connecting to AP.

endmenu
```
